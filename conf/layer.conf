## conf/layer.conf
```bitbake
# We have a conf and classes directory, add to BBPATH
BBPATH .= ":${LAYERDIR}"

# We have recipes-* directories, add to BBFILES
BBFILES += "${LAYERDIR}/recipes-*/*/*.bb \
	${LAYERDIR}/recipes-*/*/*.bbappend"

BBFILE_COLLECTIONS += "rpi3-bt-support"
BBFILE_PATTERN_rpi3-bt-support = "^${LAYERDIR}/"
BBFILE_PRIORITY_rpi3-bt-support = "10"
LAYERDEPENDS_rpi3-bt-support = "raspberrypi"
```
